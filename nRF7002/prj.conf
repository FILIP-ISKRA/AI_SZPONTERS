## CMakeLists.txt
```
#
# Copyright (c) 2024 Nordic Semiconductor ASA
#
# SPDX-License-Identifier: LicenseRef-Nordic-5-Clause
#

cmake_minimum_required(VERSION 3.20.0)

find_package(Zephyr REQUIRED HINTS $ENV{ZEPHYR_BASE})
project(project)

target_sources(app PRIVATE src/main.c)
target_sources(app PRIVATE src/ble_central_rx.c)
target_sources(app PRIVATE src/credentials_provision.c)
target_sources(app PRIVATE src/data.c)
target_sources(app PRIVATE src/node_socket_client.c)
target_sources(app PRIVATE src/predictor.c)
target_sources(app PRIVATE src/paired_devices.c)
target_include_directories(app PRIVATE src)

set(app_generated_binary_dir ${APPLICATION_BINARY_DIR}/generated)
set(index_html_file ${APPLICATION_SOURCE_DIR}/src/index.html)
set(index_html_inc_file ${app_generated_binary_dir}/index_html.inc)
set(pairing_html_file ${APPLICATION_SOURCE_DIR}/src/pairing.html)
set(pairing_html_inc_file ${app_generated_binary_dir}/pairing_html.inc)

generate_inc_file_for_target(app ${index_html_file} ${index_html_inc_file})
add_definitions(-DHTTP_SERVER_INDEX_HTML_INC="${index_html_inc_file}")
generate_inc_file_for_target(app ${pairing_html_file} ${pairing_html_inc_file})
add_definitions(-DHTTP_SERVER_PAIRING_HTML_INC="${pairing_html_inc_file}")

if(CONFIG_NET_SOCKETS_SOCKOPT_TLS)
  message(WARNING "Credentials are exposed in non-secure memory. This should be avoided in production.")

  set(app_certs_binary_dir ${APPLICATION_BINARY_DIR}/credentials)

  # Function to process a certificate file and create a corresponding .inc file and compiler definition
  # used to assign C variables that are used in main.c.
  function(process_certificate definition_name file_name)
    set(cert_file ${APPLICATION_SOURCE_DIR}/credentials/${file_name})
    if(EXISTS ${cert_file})
      message(STATUS "${file_name} found")

      get_filename_component(file_base_name ${file_name} NAME_WE)
      set(inc_file_name ${file_base_name}.inc)

      set(inc_file_path ${app_certs_binary_dir}/${inc_file_name})
      generate_inc_file_for_target(app ${cert_file} ${inc_file_path})

      # Define a compiler macro with the path to the generated .inc file,
      # allowing it to be included in the source code.
      add_definitions(-D${definition_name}="${inc_file_path}")
    endif()
  endfunction()

  # Process each certificate file by generating a .inc file and defining a corresponding macro.
  process_certificate("HTTP_SERVER_CA_CERT" "server_certificate.pem")
  process_certificate("HTTP_SERVER_PRIVATE_KEY" "server_private_key.pem")
endif()
```

## Kconfig
```
#
# Copyright (c) 2024 Nordic Semiconductor ASA
#
# SPDX-License-Identifier: LicenseRef-Nordic-5-Clause
#

menu "HTTP server sample"

config HTTP_SERVER_SAMPLE_PEER_VERIFICATION_REQUIRE
	bool "Peer verification"
	help
	  Enable this option to make the server sample require TLS peer verification.
	  Enabling peer verification ensures that the server validates the authenticity
	  of the client during TLS/SSL handshake. This helps enhance the security of
	  communications by verifying the identity of the connecting peer.

config HTTP_SERVER_SAMPLE_PORT
	int "Server Port"
	default 443 if NET_SOCKETS_SOCKOPT_TLS
	default 80

config HTTP_SERVER_SAMPLE_CLIENTS_MAX
	int "Maximum clients"
	default 1
	help
	  This option sets the maximum number of concurrent clients.
	  Increasing this option will impact the performance of the server and increase the
	  total memory footprint as each client instance has its own thread with a dedicated stack.
	  This option sets the number of maximum concurrecnt clients per IP family, meaning that
	  if both IPv4 and IPv6 is enabled, a total of 4 clients can be connected at the same time.

config HTTP_SERVER_SAMPLE_SERVER_CERTIFICATE_SEC_TAG
	int "Server Certificate Security Tag"
	default 1
	help
	  This option sets the security tag for the credentials used in TLS.

config HTTP_SERVER_SAMPLE_STACK_SIZE
	int "Thread Stack Size"
	default 4096
	help
	  This option sets the stack size for the threads used in the sample.

config HTTP_SERVER_SAMPLE_RECEIVE_BUFFER_SIZE
	int "Receive Buffer Size"
	default 1024
	help
	  This option sets the receive buffer size for the sockets used in the sample.

config HTTP_SERVER_SAMPLE_BLE_SCAN
	bool "Enable BLE scanner"
	depends on BT
	default n
	help
	  Enable continuous Bluetooth LE scanning in observer role.

config HTTP_SERVER_SAMPLE_PAIRED_MAX
	int "Maximum paired BLE runes in RAM"
	default 16
	range 1 64
	help
	  Maximum number of paired BLE MAC addresses kept in RAM.

config HTTP_SERVER_SAMPLE_CLOUD_HOST
	string "Cloud destination host"
	default "example.com"
	help
	  Domain name (or IP) of the cloud endpoint that receives
	  temperature events from paired runes.

config HTTP_SERVER_SAMPLE_CLOUD_PORT
	int "Cloud destination port"
	default 80
	range 1 65535
	help
	  TCP port used for forwarding temperature events.

config HTTP_SERVER_SAMPLE_CLOUD_PATH
	string "Cloud destination HTTP path"
	default "/api/temperature"
	help
	  HTTP path used in POST requests sent to the cloud destination.

if HTTP_SERVER_SAMPLE_BLE_SCAN

config HTTP_SERVER_SAMPLE_BLE_FILTER_BY_NAME
	bool "Filter by BLE device name"
	default y
	help
	  Match advertising packets when the decoded device name contains
	  the configured filter string.

config HTTP_SERVER_SAMPLE_BLE_NAME_FILTER
	string "BLE name filter"
	default "SZPON"
	depends on HTTP_SERVER_SAMPLE_BLE_FILTER_BY_NAME
	help
	  Substring used to match device names in advertisement data.

config HTTP_SERVER_SAMPLE_BLE_FILTER_BY_COMPANY_ID
	bool "Filter by BLE Company ID"
	default y
	help
	  Match advertising packets containing manufacturer data with
	  the configured Bluetooth SIG Company Identifier.

config HTTP_SERVER_SAMPLE_BLE_COMPANY_ID
	hex "BLE Company ID"
	default 0x0059
	depends on HTTP_SERVER_SAMPLE_BLE_FILTER_BY_COMPANY_ID
	range 0x0000 0xFFFF
	help
	  Bluetooth SIG Company Identifier used to match manufacturer data.

endif

config APP_NODE_SOCKET_CLIENT
	bool "Enable Node TCP client heartbeat"
	default y
	help
	  Enable periodic outbound TCP connection from board firmware to an external
	  Node.js socket server.

config APP_NODE_SOCKET_SERVER_IPV4
	string "Node server IPv4 address"
	default "10.42.0.1"
	help
	  IPv4 address of the machine running the Node.js TCP server.

config APP_NODE_SOCKET_SERVER_PORT
	int "Node server TCP port"
	default 19001
	range 1 65535
	help
	  TCP port used by the Node.js server.

config APP_NODE_SOCKET_CLIENT_INTERVAL_SEC
	int "Heartbeat interval (seconds)"
	default 15
	range 1 3600
	help
	  Delay between consecutive heartbeat attempts.

config APP_NODE_SOCKET_CLIENT_STACK_SIZE
	int "Node TCP client stack size"
	default 2048
	range 1024 8192
	help
	  Stack size for the TCP client thread.

module = HTTP_SERVER_SAMPLE
module-str = HTTP server sample
source "$(ZEPHYR_BASE)/subsys/logging/Kconfig.template.log_config"

menu "Zephyr Kernel"
source "Kconfig.zephyr"
endmenu

endmenu
```

## Kconfig.sysbuild
```
#
# Copyright (c) 2024 Nordic Semiconductor ASA
#
# SPDX-License-Identifier: LicenseRef-Nordic-5-Clause
#

config WIFI_NRF70
	default y if BOARD_NRF7002DK_NRF5340_CPUAPP_NS || \
		     BOARD_NRF54L15DK_NRF54L15_CPUAPP || \
		     BOARD_NRF5340DK_NRF5340_CPUAPP_NS || \
		     BOARD_NRF54LM20DK_NRF54LM20A_CPUAPP

source "share/sysbuild/Kconfig"

config NRF_DEFAULT_BLUETOOTH
	default y if BOARD_NRF7002DK_NRF5340_CPUAPP_NS || \
		     BOARD_NRF5340DK_NRF5340_CPUAPP_NS
```

## prj.conf
```kconfig
#
# Copyright (c) 2024 Nordic Semiconductor ASA
#
# SPDX-License-Identifier: LicenseRef-Nordic-5-Clause
#

# General
CONFIG_LOG=y
CONFIG_ASSERT=y
CONFIG_MAIN_STACK_SIZE=4096
CONFIG_TEST_RANDOM_GENERATOR=y
CONFIG_RESET_ON_FATAL_ERROR=n

# LED Control
CONFIG_DK_LIBRARY=y

# Networking config
CONFIG_NETWORKING=y
CONFIG_NET_CONNECTION_MANAGER=y
CONFIG_NET_IPV4=y
CONFIG_NET_IPV6=y
CONFIG_NET_TCP=y
CONFIG_NET_UDP=y
CONFIG_NET_SOCKETS=y
CONFIG_POSIX_API=y
CONFIG_MDNS_RESPONDER=y
# CONFIG_DNS_SD=y
# CONFIG_MDNS_RESPONDER_DNS_SD=y
CONFIG_NET_HOSTNAME_ENABLE=y
# CONFIG_NET_HOSTNAME_UNIQUE=n
CONFIG_NET_HOSTNAME="heimdall"
CONFIG_NET_MAX_CONN=10
CONFIG_NET_MAX_CONTEXTS=20

# Network buffers
CONFIG_NET_PKT_RX_COUNT=64
CONFIG_NET_PKT_TX_COUNT=48
CONFIG_NET_BUF_RX_COUNT=96
CONFIG_NET_BUF_TX_COUNT=72

# HTTP
CONFIG_HTTP_PARSER=y
CONFIG_HTTP_PARSER_URL=y

# Bluetooth central receiver
CONFIG_BT=y
CONFIG_BT_CENTRAL=y
CONFIG_BT_OBSERVER=y
CONFIG_BT_GATT_CLIENT=y
CONFIG_BT_DEVICE_NAME="nRF7002-central"
CONFIG_BT_MAX_CONN=1

# UART logging
CONFIG_SERIAL=y
CONFIG_CONSOLE=y
CONFIG_UART_CONSOLE=y
CONFIG_LOG_BACKEND_UART=y
```

## boards/nrf5340dk_nrf5340_cpuapp_ns.conf
```kconfig
#
# Copyright (c) 2025 Nordic Semiconductor ASA
#
# SPDX-License-Identifier: LicenseRef-Nordic-5-Clause
#

# Optimize TF-M
CONFIG_TFM_PROFILE_TYPE_SMALL=y
CONFIG_PM_PARTITION_SIZE_TFM_SRAM=0xc000
CONFIG_PM_PARTITION_SIZE_TFM=0x20000

# Optimize Wi-Fi stack to save some memory
CONFIG_HEAP_MEM_POOL_SIZE=40144
CONFIG_NRF_WIFI_CTRL_HEAP_SIZE=20000
CONFIG_NRF_WIFI_DATA_HEAP_SIZE=59856
CONFIG_HEAP_MEM_POOL_IGNORE_MIN=y
CONFIG_NRF70_RX_NUM_BUFS=16
CONFIG_NRF70_MAX_TX_AGGREGATION=4

# Wi-Fi
CONFIG_WIFI=y
CONFIG_WIFI_NRF70=y
CONFIG_WIFI_NM_WPA_SUPPLICANT=y
CONFIG_NET_L2_ETHERNET=y
CONFIG_L2_WIFI_CONNECTIVITY_AUTO_CONNECT=y

# IP address config
CONFIG_NET_CONFIG_INIT_TIMEOUT=0

# DNS
CONFIG_MDNS_RESPONDER=y
CONFIG_DNS_SD=y
CONFIG_MDNS_RESPONDER_DNS_SD=y
CONFIG_NET_HOSTNAME_ENABLE=y
CONFIG_NET_HOSTNAME_UNIQUE=n
CONFIG_NET_HOSTNAME="httpserver"
CONFIG_POSIX_SINGLE_PROCESS=n

# Zephyr NET Connection Manager connectivity layer
CONFIG_L2_WIFI_CONNECTIVITY=y
CONFIG_L2_WIFI_CONNECTIVITY_AUTO_CONNECT=n
CONFIG_L2_WIFI_CONNECTIVITY_AUTO_DOWN=n
CONFIG_MAIN_STACK_SIZE=6144

# mbedTLS and sockets
CONFIG_ZVFS_OPEN_MAX=25

# DHCPv4
CONFIG_NET_DHCPV4=y

# Shell and Wi-fi Credentials
CONFIG_SHELL=y
CONFIG_NET_SHELL=y
CONFIG_SHELL_STACK_SIZE=6144
CONFIG_NET_L2_WIFI_SHELL=y
CONFIG_WIFI_CREDENTIALS=y
CONFIG_WIFI_CREDENTIALS_SHELL=y

# Floating-point printf support
CONFIG_CBPRINTF_FP_SUPPORT=y
```

## boards/nrf7002dk_nrf5340_cpuapp_ns.conf
```kconfig
#
# Copyright (c) 2024 Nordic Semiconductor ASA
#
# SPDX-License-Identifier: LicenseRef-Nordic-5-Clause
#

# Optimize TF-M
CONFIG_TFM_PROFILE_TYPE_SMALL=y
CONFIG_PM_PARTITION_SIZE_TFM_SRAM=0xc000
CONFIG_PM_PARTITION_SIZE_TFM=0x20000

# Optimize Wi-Fi stack to save some memory
CONFIG_HEAP_MEM_POOL_SIZE=40144
CONFIG_NRF_WIFI_CTRL_HEAP_SIZE=20000
CONFIG_NRF_WIFI_DATA_HEAP_SIZE=59856
CONFIG_HEAP_MEM_POOL_IGNORE_MIN=y
CONFIG_NRF70_RX_NUM_BUFS=16
CONFIG_NRF70_MAX_TX_AGGREGATION=4

# Wi-Fi
CONFIG_WIFI=y
CONFIG_WIFI_NRF70=y
CONFIG_WIFI_NM_WPA_SUPPLICANT=y
CONFIG_NET_L2_ETHERNET=y
CONFIG_L2_WIFI_CONNECTIVITY_AUTO_CONNECT=y

# IP address config
CONFIG_NET_CONFIG_INIT_TIMEOUT=0

# DNS
CONFIG_MDNS_RESPONDER=y
CONFIG_DNS_SD=y
CONFIG_MDNS_RESPONDER_DNS_SD=y
CONFIG_NET_HOSTNAME_ENABLE=y
CONFIG_NET_HOSTNAME_UNIQUE=n
CONFIG_NET_HOSTNAME="httpserver"
CONFIG_POSIX_SINGLE_PROCESS=n

# Zephyr NET Connection Manager connectivity layer
CONFIG_L2_WIFI_CONNECTIVITY=y
CONFIG_L2_WIFI_CONNECTIVITY_AUTO_CONNECT=n
CONFIG_L2_WIFI_CONNECTIVITY_AUTO_DOWN=n
CONFIG_MAIN_STACK_SIZE=6144

# mbedTLS and sockets
CONFIG_ZVFS_OPEN_MAX=25

# DHCPv4
CONFIG_NET_DHCPV4=y

# Shell and Wi-fi Credentials
CONFIG_SHELL=y
CONFIG_NET_SHELL=y
CONFIG_SHELL_STACK_SIZE=6144
CONFIG_NET_L2_WIFI_SHELL=y
CONFIG_WIFI_CREDENTIALS=y
CONFIG_WIFI_CREDENTIALS_SHELL=y

# Floating-point printf support
CONFIG_CBPRINTF_FP_SUPPORT=y
```

## src/ble_central_rx.c
```c
/*
 * Minimal BLE Central receiver for nRF54L15 sensor stream.
 */

#include <string.h>
#include <errno.h>

#include <zephyr/kernel.h>
#include <zephyr/logging/log.h>
#include <zephyr/sys/byteorder.h>

#include <zephyr/bluetooth/bluetooth.h>
#include <zephyr/bluetooth/conn.h>
#include <zephyr/bluetooth/gatt.h>
#include <zephyr/bluetooth/hci.h>

#include "ble_central_rx.h"
#include "data.h"
#include "paired_devices.h"

LOG_MODULE_REGISTER(ble_central_rx, LOG_LEVEL_INF);

enum sensor_uuid_idx {
	SENSOR_IDX_DISTANCE,
	SENSOR_IDX_LIGHT,
	SENSOR_IDX_TEMP,
	SENSOR_IDX_HUM,
	SENSOR_IDX_PRESS,
	SENSOR_COUNT
};

static struct bt_conn *default_conn;
static struct bt_gatt_discover_params discover_params;
static uint16_t value_handles[SENSOR_COUNT];
static struct k_work_delayable poll_work;
static struct bt_gatt_read_params read_params;
static int current_read_idx = -1;
static struct sensor_sample cycle_sample;
static uint8_t cycle_mask;

#define SENSOR_MASK_TEMP BIT(0)
#define SENSOR_MASK_HUM BIT(1)
#define SENSOR_MASK_PRESS BIT(2)
#define SENSOR_MASK_LIGHT BIT(3)
#define SENSOR_MASK_REQUIRED (SENSOR_MASK_TEMP | SENSOR_MASK_HUM | SENSOR_MASK_PRESS | SENSOR_MASK_LIGHT)

static struct bt_uuid_128 sensor_service_uuid = BT_UUID_INIT_128(
	BT_UUID_128_ENCODE(0x12345678, 0x1234, 0x5678, 0x1234, 0x567812345678));
static struct bt_uuid_128 distance_uuid = BT_UUID_INIT_128(
	BT_UUID_128_ENCODE(0x12345678, 0x1234, 0x5678, 0x1234, 0x567812345679));
static struct bt_uuid_128 light_uuid = BT_UUID_INIT_128(
	BT_UUID_128_ENCODE(0x12345678, 0x1234, 0x5678, 0x1234, 0x56781234567A));
static struct bt_uuid_128 temp_uuid = BT_UUID_INIT_128(
	BT_UUID_128_ENCODE(0x12345678, 0x1234, 0x5678, 0x1234, 0x56781234567B));
static struct bt_uuid_128 hum_uuid = BT_UUID_INIT_128(
	BT_UUID_128_ENCODE(0x12345678, 0x1234, 0x5678, 0x1234, 0x56781234567C));
static struct bt_uuid_128 press_uuid = BT_UUID_INIT_128(
	BT_UUID_128_ENCODE(0x12345678, 0x1234, 0x5678, 0x1234, 0x56781234567D));

static const struct bt_uuid *sensor_uuids[SENSOR_COUNT] = {
	[SENSOR_IDX_DISTANCE] = &distance_uuid.uuid,
	[SENSOR_IDX_LIGHT] = &light_uuid.uuid,
	[SENSOR_IDX_TEMP] = &temp_uuid.uuid,
	[SENSOR_IDX_HUM] = &hum_uuid.uuid,
	[SENSOR_IDX_PRESS] = &press_uuid.uuid,
};

static const char *sensor_names[SENSOR_COUNT] = {
	[SENSOR_IDX_DISTANCE] = "distance",
	[SENSOR_IDX_LIGHT] = "light",
	[SENSOR_IDX_TEMP] = "temp",
	[SENSOR_IDX_HUM] = "humidity",
	[SENSOR_IDX_PRESS] = "pressure",
};

static void device_found(const bt_addr_le_t *addr, int8_t rssi, uint8_t type,
			 struct net_buf_simple *ad);
static void start_next_read_cycle(int start_idx);

static void log_sensor_value(int idx, const void *data, uint16_t length)
{
	switch (idx) {
	case SENSOR_IDX_DISTANCE:
		if (length >= 2) {
			uint16_t mm = sys_get_le16(data);

			LOG_INF("Distance: %u mm", mm);
		}
		break;
	case SENSOR_IDX_LIGHT:
		if (length >= 2) {
			uint16_t raw = sys_get_le16(data);

			LOG_INF("Light(raw): %u", raw);
		}
		break;
	case SENSOR_IDX_TEMP:
		if (length >= 2) {
			int16_t c_centi = (int16_t)sys_get_le16(data);
			int16_t abs_val = c_centi >= 0 ? c_centi : -c_centi;

			LOG_INF("Temp: %d.%02d C", c_centi / 100, abs_val % 100);
		}
		break;
	case SENSOR_IDX_HUM:
		if (length >= 2) {
			uint16_t h_centi = sys_get_le16(data);

			LOG_INF("Humidity: %u.%02u %%", h_centi / 100, h_centi % 100);
		}
		break;
	case SENSOR_IDX_PRESS:
		if (length >= 4) {
			uint32_t pa = sys_get_le32(data);

			LOG_INF("Pressure: %u.%02u hPa", pa / 100, pa % 100);
		}
		break;
	default:
		break;
	}
}

static void store_sensor_value(int idx, const void *data, uint16_t length)
{
	switch (idx) {
	case SENSOR_IDX_LIGHT:
		if (length >= 2) {
			uint16_t raw = sys_get_le16(data);

			cycle_sample.light = (double)raw;
			cycle_mask |= SENSOR_MASK_LIGHT;
		}
		break;
	case SENSOR_IDX_TEMP:
		if (length >= 2) {
			int16_t c_centi = (int16_t)sys_get_le16(data);

			cycle_sample.temperature = ((double)c_centi) / 100.0;
			cycle_mask |= SENSOR_MASK_TEMP;
		}
		break;
	case SENSOR_IDX_HUM:
		if (length >= 2) {
			uint16_t h_centi = sys_get_le16(data);

			cycle_sample.humidity = ((double)h_centi) / 100.0;
			cycle_mask |= SENSOR_MASK_HUM;
		}
		break;
	case SENSOR_IDX_PRESS:
		if (length >= 4) {
			uint32_t pa = sys_get_le32(data);

			cycle_sample.pressure = ((double)pa) / 100.0;
			cycle_mask |= SENSOR_MASK_PRESS;
		}
		break;
	default:
		break;
	}
}

static int sensor_index_from_uuid(const struct bt_uuid *uuid)
{
	for (int i = 0; i < SENSOR_COUNT; i++) {
		if (bt_uuid_cmp(uuid, sensor_uuids[i]) == 0) {
			return i;
		}
	}

	return -1;
}

static uint8_t read_cb(struct bt_conn *conn, uint8_t err,
			      struct bt_gatt_read_params *params,
			      const void *data, uint16_t length)
{
	ARG_UNUSED(conn);
	ARG_UNUSED(params);

	if (err) {
		if (current_read_idx >= 0 && current_read_idx < SENSOR_COUNT) {
			LOG_ERR("Read failed for %s (err 0x%02x)",
				sensor_names[current_read_idx], err);
		} else {
			LOG_ERR("Read failed (err 0x%02x)", err);
		}

		start_next_read_cycle(current_read_idx + 1);
		return BT_GATT_ITER_STOP;
	}

	if (!data) {
		start_next_read_cycle(current_read_idx + 1);
		return BT_GATT_ITER_STOP;
	}

	if (current_read_idx >= 0 && current_read_idx < SENSOR_COUNT) {
		store_sensor_value(current_read_idx, data, length);
		log_sensor_value(current_read_idx, data, length);
	}

	start_next_read_cycle(current_read_idx + 1);
	return BT_GATT_ITER_STOP;
}

static void start_next_read_cycle(int start_idx)
{
	if (!default_conn) {
		return;
	}

	if (start_idx == 0) {
		struct sensor_sample newest;

		if (sensor_ringbuffer_get_latest(&sensor_data, 0U, &newest)) {
			cycle_sample = newest;
		} else {
			cycle_sample = (struct sensor_sample){ 0 };
		}

		cycle_mask = 0U;
	}

	for (int i = start_idx; i < SENSOR_COUNT; i++) {
		int err;

		if (!value_handles[i]) {
			continue;
		}

		current_read_idx = i;
		(void)memset(&read_params, 0, sizeof(read_params));
		read_params.func = read_cb;
		read_params.handle_count = 1;
		read_params.single.handle = value_handles[i];
		read_params.single.offset = 0;

		err = bt_gatt_read(default_conn, &read_params);
		if (err) {
			LOG_ERR("Read start failed for %s: %d", sensor_names[i], err);
			continue;
		}

		return;
	}

	if ((cycle_mask & SENSOR_MASK_REQUIRED) == SENSOR_MASK_REQUIRED) {
		sensor_ringbuffer_push(&sensor_data, cycle_sample);
		LOG_INF("Buffered sample T=%.2fC H=%.2f%% P=%.2fhPa L=%.0f",
			cycle_sample.temperature,
			cycle_sample.humidity,
			cycle_sample.pressure,
			cycle_sample.light);
	} else {
		LOG_WRN("Skipping buffer push, incomplete sensor set (mask 0x%02x)", cycle_mask);
	}

	k_work_reschedule(&poll_work, K_SECONDS(1));
}

static void poll_work_handler(struct k_work *work)
{
	ARG_UNUSED(work);

	if (!default_conn) {
		return;
	}

	start_next_read_cycle(0);
}

static uint8_t discover_func(struct bt_conn *conn, const struct bt_gatt_attr *attr,
			     struct bt_gatt_discover_params *params)
{
	if (!attr) {
		LOG_INF("Discovery finished");

		if (params->type == BT_GATT_DISCOVER_CHARACTERISTIC) {
			k_work_reschedule(&poll_work, K_NO_WAIT);
		}

		(void)memset(params, 0, sizeof(*params));
		return BT_GATT_ITER_STOP;
	}

	if (params->type == BT_GATT_DISCOVER_PRIMARY) {
		const struct bt_gatt_service_val *svc = attr->user_data;

		discover_params.uuid = NULL;
		discover_params.start_handle = attr->handle + 1;
		discover_params.end_handle = svc->end_handle;
		discover_params.type = BT_GATT_DISCOVER_CHARACTERISTIC;

		if (bt_gatt_discover(conn, &discover_params) == 0) {
			return BT_GATT_ITER_STOP;
		}

		LOG_ERR("Characteristic discovery start failed");
		return BT_GATT_ITER_STOP;
	}

	if (params->type == BT_GATT_DISCOVER_CHARACTERISTIC) {
		const struct bt_gatt_chrc *chrc = attr->user_data;
		int idx = sensor_index_from_uuid(chrc->uuid);

		if (idx >= 0) {
			LOG_INF("Found char: %s (value_handle 0x%04x)",
				sensor_names[idx], chrc->value_handle);
			value_handles[idx] = chrc->value_handle;
		}
	}

	return BT_GATT_ITER_CONTINUE;
}

static void start_scan(void)
{
	int err = bt_le_scan_start(BT_LE_SCAN_ACTIVE, device_found);

	if (err) {
		LOG_ERR("Scanning failed to start (%d)", err);
		return;
	}

	LOG_INF("Scanning for paired BLE devices...");
}

static void device_found(const bt_addr_le_t *addr, int8_t rssi, uint8_t type,
			 struct net_buf_simple *ad)
{
	char addr_str[BT_ADDR_LE_STR_LEN];
	int err;

	ARG_UNUSED(ad);

	if (default_conn) {
		return;
	}

	if (type != BT_GAP_ADV_TYPE_ADV_IND && type != BT_GAP_ADV_TYPE_ADV_DIRECT_IND &&
	    type != BT_GAP_ADV_TYPE_EXT_ADV) {
		return;
	}

	if (!paired_devices_is_paired_addr(addr)) {
		bt_addr_le_to_str(addr, addr_str, sizeof(addr_str));
		LOG_DBG("Ignoring unpaired advertiser %s", addr_str);
		return;
	}

	bt_addr_le_to_str(addr, addr_str, sizeof(addr_str));
	LOG_INF("Found paired advertiser %s, RSSI %d", addr_str, rssi);

	(void)bt_le_scan_stop();

	err = bt_conn_le_create(addr, BT_CONN_LE_CREATE_CONN,
				BT_LE_CONN_PARAM_DEFAULT, &default_conn);
	if (err) {
		LOG_ERR("Create conn failed (%d)", err);
		start_scan();
	}
}

static void connected(struct bt_conn *conn, uint8_t conn_err)
{
	if (conn != default_conn) {
		return;
	}

	if (conn_err) {
		LOG_ERR("Connection failed (err 0x%02x)", conn_err);
		bt_conn_unref(default_conn);
		default_conn = NULL;
		start_scan();
		return;
	}

	LOG_INF("Connected, discovering service...");

	(void)memset(value_handles, 0, sizeof(value_handles));
	current_read_idx = -1;

	discover_params.uuid = &sensor_service_uuid.uuid;
	discover_params.func = discover_func;
	discover_params.start_handle = BT_ATT_FIRST_ATTRIBUTE_HANDLE;
	discover_params.end_handle = BT_ATT_LAST_ATTRIBUTE_HANDLE;
	discover_params.type = BT_GATT_DISCOVER_PRIMARY;

	if (bt_gatt_discover(conn, &discover_params)) {
		LOG_ERR("Service discovery start failed");
	}
}

static void disconnected(struct bt_conn *conn, uint8_t reason)
{
	if (conn != default_conn) {
		return;
	}

	LOG_INF("Disconnected (reason 0x%02x)", reason);

	bt_conn_unref(default_conn);
	default_conn = NULL;
	(void)memset(value_handles, 0, sizeof(value_handles));
	current_read_idx = -1;
	k_work_cancel_delayable(&poll_work);
	start_scan();
}

BT_CONN_CB_DEFINE(conn_callbacks) = {
	.connected = connected,
	.disconnected = disconnected,
};

int ble_central_rx_start(void)
{
	int err;

	k_work_init_delayable(&poll_work, poll_work_handler);

	err = bt_enable(NULL);
	if (err) {
		LOG_ERR("Bluetooth init failed (%d)", err);
		return err;
	}

	start_scan();

	return 0;
}
```

## src/ble_central_rx.h
```c
/*
 * BLE Central receiver module for sensor stream polling.
 */

#ifndef BLE_CENTRAL_RX_H_
#define BLE_CENTRAL_RX_H_

int ble_central_rx_start(void);

#endif /* BLE_CENTRAL_RX_H_ */
```

## src/data.c
```c
#include "data.h"

struct sensor_ringbuffer sensor_data = {
	.head = 0U,
	.count = 0U,
};
```

## src/data.h
```c
#ifndef DATA_H_
#define DATA_H_

#include <stdbool.h>
#include <stddef.h>

#define SENSOR_RINGBUFFER_CAPACITY 1024U

struct sensor_sample {
	double temperature;
	double humidity;
	double pressure;
	double light;
};

struct sensor_ringbuffer {
	struct sensor_sample samples[SENSOR_RINGBUFFER_CAPACITY];
	size_t head;
	size_t count;
};

extern struct sensor_ringbuffer sensor_data;

static inline void sensor_ringbuffer_reset(struct sensor_ringbuffer *rb)
{
	rb->head = 0U;
	rb->count = 0U;
}

static inline size_t sensor_ringbuffer_size(const struct sensor_ringbuffer *rb)
{
	return rb->count;
}

static inline bool sensor_ringbuffer_is_empty(const struct sensor_ringbuffer *rb)
{
	return rb->count == 0U;
}

static inline bool sensor_ringbuffer_is_full(const struct sensor_ringbuffer *rb)
{
	return rb->count == SENSOR_RINGBUFFER_CAPACITY;
}

/* Store the newest value and overwrite the oldest when full. */
static inline void sensor_ringbuffer_push(struct sensor_ringbuffer *rb,
					      struct sensor_sample sample)
{
	rb->samples[rb->head] = sample;
	rb->head = (rb->head + 1U) % SENSOR_RINGBUFFER_CAPACITY;

	if (rb->count < SENSOR_RINGBUFFER_CAPACITY) {
		rb->count++;
	}
}

static inline void sensor_ringbuffer_push_values(struct sensor_ringbuffer *rb,
						 double temperature,
						 double humidity,
						 double pressure,
						 double light)
{
	struct sensor_sample sample = {
		.temperature = temperature,
		.humidity = humidity,
		.pressure = pressure,
		.light = light,
	};

	sensor_ringbuffer_push(rb, sample);
}

/* age == 0 returns the newest sample, age == count-1 the oldest. */
static inline bool sensor_ringbuffer_get_latest(const struct sensor_ringbuffer *rb,
						       size_t age,
						       struct sensor_sample *value_out)
{
	size_t index;

	if (age >= rb->count || value_out == NULL) {
		return false;
	}

	index = (rb->head + SENSOR_RINGBUFFER_CAPACITY - 1U - age) %
		SENSOR_RINGBUFFER_CAPACITY;
	*value_out = rb->samples[index];

	return true;
}

#endif /* DATA_H_ */
```

## src/paired_devices.c
```c
#include <string.h>

#include <zephyr/kernel.h>
#include <zephyr/logging/log.h>
#include <zephyr/bluetooth/addr.h>

#include "paired_devices.h"

LOG_MODULE_REGISTER(paired_devices, LOG_LEVEL_INF);

#define MAX_PAIRED_DEVICES 8

static bt_addr_t paired_addrs[MAX_PAIRED_DEVICES];
static size_t paired_count;
static K_MUTEX_DEFINE(paired_devices_mutex);

static bool addr_exists_locked(const bt_addr_t *addr)
{
	for (size_t i = 0U; i < paired_count; i++) {
		if (bt_addr_cmp(&paired_addrs[i], addr) == 0) {
			return true;
		}
	}

	return false;
}

bool paired_devices_add_mac_string(const char *mac)
{
	bt_addr_t parsed;
	int ret;
	char addr_str[BT_ADDR_STR_LEN];

	if (mac == NULL) {
		return false;
	}

	ret = bt_addr_from_str(mac, &parsed);
	if (ret) {
		LOG_WRN("Invalid pair MAC string: %s", mac);
		return false;
	}

	k_mutex_lock(&paired_devices_mutex, K_FOREVER);

	if (addr_exists_locked(&parsed)) {
		k_mutex_unlock(&paired_devices_mutex);
		return true;
	}

	if (paired_count >= MAX_PAIRED_DEVICES) {
		k_mutex_unlock(&paired_devices_mutex);
		LOG_WRN("Paired device list full");
		return false;
	}

	paired_addrs[paired_count++] = parsed;
	k_mutex_unlock(&paired_devices_mutex);

	bt_addr_to_str(&parsed, addr_str, sizeof(addr_str));
	LOG_INF("Added paired BLE MAC %s", addr_str);
	return true;
}

bool paired_devices_is_paired_addr(const bt_addr_le_t *addr)
{
	bool found = false;

	if (addr == NULL) {
		return false;
	}

	k_mutex_lock(&paired_devices_mutex, K_FOREVER);
	for (size_t i = 0U; i < paired_count; i++) {
		if (bt_addr_cmp(&paired_addrs[i], &addr->a) == 0) {
			found = true;
			break;
		}
	}
	k_mutex_unlock(&paired_devices_mutex);

	return found;
}
```

## src/paired_devices.h
```c
/*
 * Paired BLE device registry.
 */

#ifndef PAIRED_DEVICES_H_
#define PAIRED_DEVICES_H_

#include <stdbool.h>

#include <zephyr/bluetooth/addr.h>

bool paired_devices_add_mac_string(const char *mac);
bool paired_devices_is_paired_addr(const bt_addr_le_t *addr);

#endif /* PAIRED_DEVICES_H_ */
```
